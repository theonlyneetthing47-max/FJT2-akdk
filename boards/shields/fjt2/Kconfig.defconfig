## boards/shields/fjt2/Kconfig.defconfig
```kconfig
if SHIELD_FJT2_RIGHT

config ZMK_KEYBOARD_NAME
    default "fjt2"

endif

if SHIELD_FJT2_LEFT || SHIELD_FJT2_RIGHT

config ZMK_SPLIT
    default y

endif
```

## boards/shields/fjt2/Kconfig.shield
```kconfig
config SHIELD_FJT2_LEFT
    def_bool $(shields_list_contains,fjt2_left)
config SHIELD_FJT2_RIGHT
    def_bool $(shields_list_contains,fjt2_right)
```
